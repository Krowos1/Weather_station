#include <Wire.h>
#include <Adafruit_Sensor.h>
#include <Adafruit_BMP280.h>
#include <Adafruit_SSD1306.h> // Подключение библиотеки для OLED дисплея
#include <AHT10.h> // Подключение библиотеки для датчика влажности AHT10

#define SCREEN_WIDTH 128
#define SCREEN_HEIGHT 64

// Инициализация объектов датчика BMP280, OLED дисплея и AHT10
Adafruit_BMP280 bmp;
Adafruit_SSD1306 display(SCREEN_WIDTH, SCREEN_HEIGHT, &Wire, -1); // Используем I2C интерфейс
AHT10Class AHT10;

// Задаем массив для изображения "заставки"
static const uint8_t PROGMEM image_data_Saraarray[1024] = {
    0x00,0x00,0x00,0x00,0x00,0x00,0x00,0x00,0x00,0x00,0x00,0x00,0x00,0x00,0x00,0x00,

    0x00,0x00,0x00,0x00,0x00,0x00,0x00,0x00,0x00,0x00,0x00,0x00,0x00,0x00,0x00,0x00,
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    0x00,0x00,0x00,0x00,0x00,0x00,0x00,0x00,0x00,0x00,0x00,0x00,0x00,0x00,0x00,0x00,



};

void setup() {
  Serial.begin(9600);

  // Инициализация OLED дисплея
  if (!display.begin(SSD1306_SWITCHCAPVCC, 0x3C)) {
    Serial.println(F("SSD1306 allocation failed"));
    for (;;);
  }

  // Display the "заставка" for 3 seconds
  unsigned long startMillis = millis();
  while (millis() - startMillis < 5000) {
    display.clearDisplay();
    display.drawBitmap(0, 0, image_data_Saraarray, SCREEN_WIDTH, SCREEN_HEIGHT, SSD1306_WHITE);
    display.display();
  }
  display.clearDisplay();

  // Подключение датчика BMP280
  if (!bmp.begin(0x76)) {
    Serial.println("Could not find a valid BMP280 sensor, check wiring!");
    while (1);
  }

  if (AHT10.begin(0x38))                            // Инициализируем датчик с адресом 0x38
    Serial.println("AHT10 подключен.");            // Если удачно печатаем "AHT10 подключен."
  else {
    Serial.println("AHT10 не подключен.");         // Если не удачно печатаем "AHT10 не подключен."
    while (1);                                      // Заканчиваем выполнение
  }

  Serial.println(F("BMP280 and AHT10 test"));
}

void loop() {
  // Чтение данных с датчика BMP280
  float temperature = bmp.readTemperature();
  float pressure_pa = bmp.readPressure(); // Давление в паскалях
  float pressure_mmHg = pressure_pa * 0.00750062; // Преобразование к мм рт. ст.

  float T = AHT10.GetTemperature();                // Считываем показание температуры
  float H = AHT10.GetHumidity();                   // Считываем показание влажности
  float D = AHT10.GetDewPoint();                   // Считываем значение точки росы для данной влажности

  // Очистка и вывод данных на OLED дисплей
  display.clearDisplay();
  display.setTextSize(1); // Устанавливаем размер букв в один раз больше
  display.setTextColor(SSD1306_WHITE);
  display.setCursor(0, 0);
  display.print("Temperature: ");
  display.print(temperature, 1);
  display.print(" C");

  display.setCursor(0, 16);
  display.print("Pressure: ");
  display.print(pressure_mmHg, 2);
  display.print(" mmHg");

  display.setCursor(0, 32);
  display.print("Humidity: ");
  display.print(H, 1);
  display.print(" %");

  display.setCursor(0, 48);
  display.print("Dew Point: ");
  display.print(D, 1);
  display.print(" C");

  display.display();

  // Вывод данных в Serial Monitor
  Serial.print(F("Temperature = "));
  Serial.print(temperature);
  Serial.println(" *C");

  Serial.print(F("Pressure = "));
  Serial.print(pressure_mmHg);
  Serial.println(" mmHg");

  Serial.print(F("Humidity = "));
  Serial.print(H);
  Serial.println(" %");

  Serial.print(F("Dew Point = "));
  Serial.print(D);
  Serial.println(" C");

  delay(1000);
}
